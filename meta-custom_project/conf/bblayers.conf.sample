## meta-custom_project/conf/bblayers.conf.sample
```bitbake
LCONF_VERSION = "7"

BBPATH = "${TOPDIR}"
BBFILES ?= ""

BBLAYERS ?= " \
    ##OEROOT##/../poky/meta \
    ##OEROOT##/../poky/meta-poky \
    ##OEROOT##/../meta-openembedded/meta-perl \
    ##OEROOT##/../meta-openembedded/meta-python \
    ##OEROOT##/../meta-openembedded/meta-filesystems \
    ##OEROOT##/../meta-openembedded/meta-multimedia \
    ##OEROOT##/../meta-openembedded/meta-networking \
    ##OEROOT##/../meta-openembedded/meta-webserver \
    ##OEROOT##/../meta-openembedded/meta-initramfs \
    ##OEROOT##/../meta-openembedded/meta-oe \
    ##OEROOT##/../meta-xilinx/meta-xilinx-core \
    ##OEROOT##/../meta-xilinx/meta-xilinx-bsp \
    ##OEROOT##/../meta-xilinx/meta-xilinx-pynq \
    ##OEROOT##/../meta-xilinx/meta-xilinx-contrib \
    ##OEROOT##/../meta-xilinx/meta-xilinx-standalone \
    ##OEROOT##/../meta-xilinx/meta-xilinx-vendor \
    ##OEROOT##/../meta-xilinx-tools \
    ##OEROOT##/../../meta-custom_project \
"

BBLAYERS_NON_REMOVABLE ?= " \
    ##OEROOT##/../poky/meta \
"
```

## meta-custom_project/conf/distro/include/custom_project-features.conf
```bitbake
IMAGE_FSTYPES += "tar.gz ext4 cpio.gz.u-boot"

POKY_DEFAULT_DISTRO_FEATURES = "${BUSYBOX_FEATURES}"

# Create packages that support both systemd and sysvinit
DISTRO_FEATURES_BACKFILL_CONSIDERED:remove:arm = "sysvinit systemd"
DISTRO_FEATURES_BACKFILL_CONSIDERED:remove:aarch64 = "sysvinit systemd"
DISTRO_FEATURES_BACKFILL:append:arm = " systemd"
DISTRO_FEATURES_BACKFILL:append:aarch64 = " systemd"

# BusyBox features
BUSYBOX_FEATURES = " \
	busybox-hd \
	busybox-ftpd \
	busybox-ftp \
	busybox-telnetd \
	busybox-mdev \
	busybox-inetd \
	busybox-httpd \
	"

DISTRO_FEATURES = "${DISTRO_FEATURES_DEFAULT} ${POKY_DEFAULT_DISTRO_FEATURES}"

SKIP_META_VIRT_SANITY_CHECK:zynq = "1"

VIRTUAL-RUNTIME_login_manager = "busybox"

INIT_MANAGER_DEFAULT = "systemd"
INIT_MANAGER ?= "${INIT_MANAGER_DEFAULT}"

PREFERRED_PROVIDER_virtual/boot-bin ?= "xilinx-bootbin"
PREFERRED_PROVIDER_virtual/dtb ?= "device-tree"

UBOOT_SUFFIX = "bin"

LICENSE_FLAGS_WHITELIST = " \
        xilinx "

#for installing packages - Host is the target
PACKAGE_FEED_URIS ?= "http://192.168.67.3:5678"

QB_SERIAL_OPT ?= "-serial mon:stdio -serial null"
```

## meta-custom_project/conf/distro/project.conf
```bitbake
require conf/distro/poky.conf
require conf/distro/include/custom_project-features.conf
include conf/distro/include/xilinx-mirrors.conf

DISTRO = "custom_project"
DISTRO_NAME = "custom_project Linux"
DISTRO_VERSION = "1.6+snapshot-${DATE}"
MAINTAINER = "Poky <poky@yoctoproject.org>"
TARGET_VENDOR = "-xilinx"

# Blacklist packages
INHERIT += "blacklist"
PNBLACKLIST[qemu-native] = "Only qemu-xilinx-native is support."
PNBLACKLIST[nativesdk-qemu] = "Only nativesdk-qemu is supported."
PNBLACKLIST[qemu-helper-native] = "Only qemu-xilinx-helper-native is supported."

INHERIT += "buildhistory"
BUILDHISTORY_COMMIT = "1"

#INHERIT += "archiver"

# Enable the PR Service
PRSERV_HOST ?= "localhost:0"

COPY_LIC_MANIFEST = "1"
LICENSE_CREATE_PACKAGE = "1"
BB_GENERATE_MIRROR_TARBALLS = "1"

CONNECTIVITY_CHECK_URIS = ""

# Do not include clang in generated SDKs
CLANGSDK ?= "0"

# Make sure PR service is on
#PRSERV_HOST ??= "localhost:0"
```

## meta-custom_project/conf/layer.conf
```bitbake
# We have a conf and classes directory, add to BBPATH
BBPATH .= ":${LAYERDIR}"


# We have a packages directory, add to BBFILES
BBFILES += "${LAYERDIR}/recipes-*/*/*.bb"
BBFILES += "${LAYERDIR}/recipes-*/*/*.bbappend"

BBFILE_COLLECTIONS += "custom_project"
BBFILE_PRIORITY_custom_project = "9"
BBFILE_PATTERN_custom_project := "^${LAYERDIR}/"

LAYERDEPENDS_custom_project = "\
    xilinx \
    "

LAYERSERIES_COMPAT_custom_project = "honister"
```
